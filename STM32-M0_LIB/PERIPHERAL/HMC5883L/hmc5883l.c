/*********************************Copyright (c)*********************************
**                               
**
**--------------File Info-------------------------------------------------------
** File Name:               hmc5883.c
** Last modified Date:      
** Last Version:            
** Description:             三维磁阻仪传感器
**
**------------------------------------------------------------------------------
** Created By:              wanxuncpx
** Created date:            
** Version:                 
** Descriptions:            
**
*******************************************************************************/

/******************************************************************************
更新说明:
    
******************************************************************************/

/******************************************************************************
*********************************  应 用 资 料 ********************************
******************************************************************************/

/******************************************************************************
********************************* 文件引用部分 ********************************
******************************************************************************/
#include "sensor.h"
#include "stm32_config.h"
#include "stdio.h"



/******************************************************************************
******************************* 自定义参数配置 ********************************
******************************************************************************/


/******************************************************************************
********************************* 数 据 声 明 *********************************
******************************************************************************/
/*---------------------* 
*    IMPORT:由外提供   * 
*----------------------*/
//none

/*---------------------* 
*    EXPORT:向外提供   * 
*----------------------*/
tg_HMC5883L_TYPE hmc5883l;


/******************************************************************************
********************************* 函 数 声 明 *********************************
******************************************************************************/
/*---------------------* 
*    IMPORT:由外提供   * 
*----------------------*/
//none

/*---------------------* 
*    EXPORT:向外提供   * 
*----------------------*/
//none



/******************************************************************************
*********************************  程序开始  **********************************
******************************************************************************/

/******************************************************************************
/ 函数功能:初始化HMC5883
/ 修改日期:none
/ 输入参数:none
/ 输出参数:none
/ 使用说明:none
******************************************************************************/
void  HMC5883L_Init(void)
{
   Single_Write(HMC5883L_Addr,HMC5883L_REGA,0x14);
	//	 USART_OUT(USART1,"adsfc");
   Single_Write(HMC5883L_Addr,HMC5883L_MODE,0x00);   //连续测量模式
}

/******************************************************************************
/ 函数功能:读取HMC5883的数据
/ 修改日期:none
/ 输入参数:none
/ 输出参数:none
/ 使用说明:none
******************************************************************************/
void HMC5883L_Read(tg_HMC5883L_TYPE * ptResult)
{
    uint8_t tmp[6];
    int32_t s32Val;
    
    Single_Write(HMC5883L_Addr,HMC5883L_REGA,0x14);   //30Hz
    Single_Write(HMC5883L_Addr,HMC5883L_MODE,0x00);   //连续测量模式
    Delayms(10);
		I2c_ReadBuffer(HMC5883L_Addr,HMC5883L_HX_H,6,tmp);

    ptResult->hx  = (int16_t)((tmp[0] << 8) | tmp[1])+HMC5883L_OFFSET_X;
    s32Val = (int16_t)((tmp[4] << 8) | tmp[5])+HMC5883L_OFFSET_Y;    
    s32Val = (s32Val*HMC5883L_GAIN_Y)/10000;
    ptResult->hy  = (int16_t)s32Val;
    ptResult->hz  = (int16_t)((tmp[2] << 8) | tmp[3]);
}

/******************************************************************************
/ 函数功能:启动HMC5883开始转换(适用于启动-中断-读取数据的程序)
/ 修改日期:none
/ 输入参数:none
/ 输出参数:none
/ 使用说明:启动-中断-查询 (启动)
******************************************************************************/
void HMC5883L_Start(void)
{
   if(Single_Write(HMC5883L_Addr,HMC5883L_REGA,0x14)==false)
		 USART_OUT(DEBUG_USART,"false0");    //30Hz
   if(Single_Write(HMC5883L_Addr,HMC5883L_MODE,0x00)==false)
		 USART_OUT(DEBUG_USART,"false1");    //连续测量模式
}

/******************************************************************************
/ 函数功能:读取HMC5883的数据(适用于启动-中断-读取数据的程序)
/ 修改日期:none
/ 输入参数:none
/ 输出参数:none
/ 使用说明:启动-中断-查询 (查询)
******************************************************************************/
void HMC5883L_MultRead(tg_HMC5883L_TYPE * ptResult)
{
    uint8_t tmp[6];
    int32_t s32Val;

    if(true==I2c_ReadBuffer(HMC5883L_Addr,HMC5883L_HX_H,6,tmp))   //多读读出传感器数据			
    {
        //修正数据(根据x轴修正y轴输出)
        ptResult->hx  = (int16_t)((tmp[0] << 8) | tmp[1])+HMC5883L_OFFSET_X;
        s32Val = (int16_t)((tmp[4] << 8) | tmp[5])+HMC5883L_OFFSET_Y;    
        s32Val = (s32Val*HMC5883L_GAIN_Y)/10000;
        ptResult->hy= (int16_t)s32Val;
        ptResult->hz= (int16_t)((tmp[2] << 8) | tmp[3]);
    }
		else
				USART_OUT(DEBUG_USART,"flase");
		
} 

/******************************************************************************
/ 函数功能:HMC5883校准
/ 修改日期:none
/ 输入参数:none
/ 输出参数:none
/ 使用说明:启动-中断-查询 (查询)
******************************************************************************/
void HMC5883L_Calibrate(void)
{
   Single_Write(HMC5883L_Addr,HMC5883L_REGA,0x15);   //30Hz,启动自检模式
   Single_Write(HMC5883L_Addr,HMC5883L_MODE,0x01);   //单一测量模式
   Delayms(10);
   Single_Write(HMC5883L_Addr,HMC5883L_REGA,0x14);
   Single_Write(HMC5883L_Addr,HMC5883L_MODE,0x00);   //回到工作模式
}



/******************************************************************************
/ 函数功能:打印HMC的传感器数据
/ 修改日期:none
/ 输入参数:none
/ 输出参数:none
/ 使用说明:none
******************************************************************************/
void HMC5883L_Printf(tg_HMC5883L_TYPE * ptResult)
{
    int16_t x,y;
    float angle;
	__align(8) char temp [160];
    
    x = ptResult->hx;
    y = ptResult->hy;
    //求出方向
    if(x>0x7fff)x-=0xffff;
    if(y>0x7fff)y-=0xffff;
    angle= atan2(y,x) * (180 / 3.14159265) + 180;   //160us计算时间
    ptResult->ha = (int16_t)(angle*10);   // 得到方向精确到0.1°
    //USART_OUT(USART1,"\r\n HMC5883L:   hx: %d,   hy: %d,   hz: %d,   %d   \r\n",ptResult->hx, ptResult->hy, ptResult->hz, ptResult->ha/10);
//    USART_OUT(USART1,"\r\n HMC5883L:   hx: %d,   hy: %d,   %d   \r\n",ptResult->hx, ptResult->hy, ptResult->ha/10);
    //sprintf((char*)temp,"Pitch:%3f Roll:%3f Yaw:%3f",Pitch,Roll,Yaw);
	sprintf((char*)temp,"\r\nhx: %4d hy: %4d, %4d  ",ptResult->hx, ptResult->hy,ptResult->ha/10);
	USART_OUT(DEBUG_USART,temp);
}




